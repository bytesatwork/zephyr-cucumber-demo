## app/boards/native_sim_64.conf
```kconfig
CONFIG_CPP=y
CONFIG_REQUIRES_FULL_LIBCPP=y
CONFIG_CPP_EXCEPTIONS=y
CONFIG_STD_CPP20=y
CONFIG_CPP_RTTI=y
CONFIG_NATIVE_SIM_SLOWDOWN_TO_REAL_TIME=n
CONFIG_SYS_CLOCK_TICKS_PER_SEC=1000
```
